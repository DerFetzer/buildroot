## configs/haierpad1043_defconfig
```kconfig
BR2_arm=y
BR2_cortex_a9=y
BR2_ARM_ENABLE_NEON=y
BR2_ARM_ENABLE_VFP=y
BR2_KERNEL_HEADERS_6_4=y
BR2_PACKAGE_HOST_GDB=y
BR2_PACKAGE_HOST_GDB_TUI=y
BR2_PACKAGE_HOST_GDB_PYTHON3=y
BR2_GDB_VERSION_12=y
BR2_CCACHE=y
BR2_ROOTFS_POST_IMAGE_SCRIPT="board/haier/pad1043/build_loader.sh board/haier/pad1043/generate_linux_compile_commands.sh"
BR2_LINUX_KERNEL=y
BR2_LINUX_KERNEL_USE_CUSTOM_CONFIG=y
BR2_LINUX_KERNEL_CUSTOM_CONFIG_FILE="board/haier/pad1043/linux.config"
BR2_LINUX_KERNEL_INSTALL_TARGET=y
BR2_PACKAGE_FB_TEST_APP=y
BR2_PACKAGE_FBDUMP=y
BR2_PACKAGE_FBGRAB=y
BR2_PACKAGE_FBV=y
BR2_PACKAGE_PYTHON3=y
BR2_PACKAGE_PYTHON3_READLINE=y
BR2_TARGET_BAREBOX=y
BR2_TARGET_BAREBOX_CUSTOM_GIT=y
BR2_TARGET_BAREBOX_CUSTOM_GIT_REPO_URL="git://git.pengutronix.de/barebox"
BR2_TARGET_BAREBOX_CUSTOM_GIT_VERSION="e6947fd17f8b4bca5b6abea04e85a4702b14cd26"
BR2_TARGET_BAREBOX_USE_CUSTOM_CONFIG=y
BR2_TARGET_BAREBOX_CUSTOM_CONFIG_FILE="board/haier/pad1043/barebox.config"
BR2_TARGET_BAREBOX_IMAGE_FILE="images/barebox-haierpad-1043.img"
```

## defconfig
```kconfig
BR2_arm=y
BR2_cortex_a9=y
BR2_ARM_ENABLE_NEON=y
BR2_ARM_ENABLE_VFP=y
BR2_KERNEL_HEADERS_6_4=y
BR2_PACKAGE_GLIBC_UTILS=y
BR2_BINUTILS_VERSION_2_41_X=y
BR2_GCC_VERSION_13_X=y
BR2_TOOLCHAIN_BUILDROOT_CXX=y
BR2_TOOLCHAIN_BUILDROOT_FORTRAN=y
BR2_GCC_ENABLE_OPENMP=y
BR2_GCC_ENABLE_GRAPHITE=y
BR2_PACKAGE_HOST_GDB=y
BR2_PACKAGE_HOST_GDB_TUI=y
BR2_PACKAGE_HOST_GDB_PYTHON3=y
BR2_GDB_VERSION_12=y
BR2_CCACHE=y
BR2_ROOTFS_POST_BUILD_SCRIPT="board/haier/pad1043/copy_fw.sh"
BR2_ROOTFS_POST_IMAGE_SCRIPT="board/haier/pad1043/build_loader.sh board/haier/pad1043/generate_linux_compile_commands.sh"
BR2_LINUX_KERNEL=y
BR2_LINUX_KERNEL_USE_CUSTOM_CONFIG=y
BR2_LINUX_KERNEL_CUSTOM_CONFIG_FILE="board/haier/pad1043/linux.config"
BR2_LINUX_KERNEL_DTS_SUPPORT=y
BR2_LINUX_KERNEL_INTREE_DTS_NAME="rk3188-haierpad-1043"
BR2_LINUX_KERNEL_DTB_OVERLAY_SUPPORT=y
BR2_LINUX_KERNEL_INSTALL_TARGET=y
BR2_PACKAGE_LINUX_TOOLS_CPUPOWER=y
BR2_PACKAGE_LINUX_TOOLS_GPIO=y
BR2_PACKAGE_FB_TEST_APP=y
BR2_PACKAGE_FBDUMP=y
BR2_PACKAGE_FBGRAB=y
BR2_PACKAGE_FBV=y
BR2_PACKAGE_BRCMFMAC_SDIO_FIRMWARE=y
BR2_PACKAGE_BRCMFMAC_SDIO_FIRMWARE_BT=y
BR2_PACKAGE_BRCMFMAC_SDIO_FIRMWARE_WIFI=y
BR2_PACKAGE_EVEMU=y
BR2_PACKAGE_EVTEST=y
BR2_PACKAGE_PYTHON3=y
BR2_PACKAGE_PYTHON3_READLINE=y
BR2_PACKAGE_BLUEZ5_UTILS=y
BR2_PACKAGE_BLUEZ5_UTILS_CLIENT=y
BR2_PACKAGE_BLUEZ5_UTILS_MONITOR=y
BR2_PACKAGE_BLUEZ5_UTILS_TOOLS=y
BR2_PACKAGE_BLUEZ5_UTILS_PLUGINS_AUDIO=y
BR2_PACKAGE_BLUEZ5_UTILS_PLUGINS_HEALTH=y
BR2_PACKAGE_BLUEZ5_UTILS_PLUGINS_HID=y
BR2_PACKAGE_BLUEZ5_UTILS_PLUGINS_MIDI=y
BR2_PACKAGE_BLUEZ5_UTILS_PLUGINS_NFC=y
BR2_PACKAGE_CONNMAN=y
BR2_PACKAGE_CONNMAN_NFTABLES=y
BR2_PACKAGE_CONNMAN_WIFI=y
BR2_PACKAGE_CONNMAN_WIREGUARD=y
BR2_PACKAGE_CONNMAN_BLUETOOTH=y
BR2_PACKAGE_CONNMAN_CLIENT=y
BR2_PACKAGE_DHCPCD=y
BR2_PACKAGE_HOSTAPD=y
BR2_PACKAGE_HOSTAPD_WPA3=y
BR2_PACKAGE_IW=y
BR2_PACKAGE_IWD=y
BR2_PACKAGE_WIRELESS_TOOLS=y
BR2_PACKAGE_WPA_SUPPLICANT_WPA3=y
BR2_PACKAGE_WPA_SUPPLICANT_CLI=y
BR2_PACKAGE_WPA_SUPPLICANT_WPA_CLIENT_SO=y
BR2_PACKAGE_WPA_SUPPLICANT_PASSPHRASE=y
BR2_TARGET_BAREBOX=y
BR2_TARGET_BAREBOX_CUSTOM_GIT=y
BR2_TARGET_BAREBOX_CUSTOM_GIT_REPO_URL="git://git.pengutronix.de/barebox"
BR2_TARGET_BAREBOX_CUSTOM_GIT_VERSION="e6947fd17f8b4bca5b6abea04e85a4702b14cd26"
BR2_TARGET_BAREBOX_USE_CUSTOM_CONFIG=y
BR2_TARGET_BAREBOX_CUSTOM_CONFIG_FILE="board/haier/pad1043/barebox.config"
BR2_TARGET_BAREBOX_IMAGE_FILE="images/barebox-haierpad-1043.img"
```

## package/brcmfmac_sdio-firmware/Config.in
```kconfig
config BR2_PACKAGE_BRCMFMAC_SDIO_FIRMWARE
	bool "brcmfmac-sdio-firmware"
	help
	  Broadcom Bluetooth and Wifi firmware.

	  https://github.com/LibreELEC/brcmfmac_sdio-firmware

if BR2_PACKAGE_BRCMFMAC_SDIO_FIRMWARE

config BR2_PACKAGE_BRCMFMAC_SDIO_FIRMWARE_BT
	bool "brcmfmac-sdio-firmware-bt"
	help
	  Raspberry Broadcom BCM43438 Bluetooth module
	  firmware. Broadcom BCM4345C0 Bluetooth module firmware.

config BR2_PACKAGE_BRCMFMAC_SDIO_FIRMWARE_WIFI
	bool "brcmfmac-sdio-firmware-wifi"
	depends on !BR2_PACKAGE_LINUX_FIRMWARE_BRCM_BCM43XXX
	help
	  Broadcom BCM43430 wifi module
	  NVRAM data. Broadcom BCM43455 wifi module NVRAM data.

comment "brcmfmac-sdio-firmware-wifi conflicts with linux-firmware Broadcom BRCM bcm43xx"
	depends on BR2_PACKAGE_LINUX_FIRMWARE_BRCM_BCM43XXX

endif
```
